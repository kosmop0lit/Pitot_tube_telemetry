#include <Wire.h>                                      // Підключаємо апаратну I2C-бібліотеку Arduino.
#include <SoftwareWire.h>                              // Підключаємо SoftwareWire 1.5.1 для другої I2C-шини.
#include <math.h>                                      // Підключаємо математичні функції sqrt() та fabs().
#define SDA2 4                                         // SDA другого BMP180 підключаємо до D4.
#define SCL2 5                                         // SCL другого BMP180 підключаємо до D5.
#define BMP_ADDR 0x77                                  // Задаємо стандартну I2C-адресу BMP180.
#define REG_ID 0xD0                                    // Задаємо адресу регістра ідентифікатора BMP180.
#define REG_CONTROL 0xF4                               // Задаємо адресу регістра керування BMP180.
#define REG_DATA 0xF6                                  // Задаємо адресу першого регістра результатів вимірювання.
#define REG_CAL 0xAA                                   // Задаємо адресу першого заводського коефіцієнта калібрування.
#define CMD_TEMP 0x2E                                  // Задаємо команду вимірювання температури.
#define CMD_PRESS 0x34                                 // Задаємо базову команду вимірювання тиску.
#define OSS 2                                           // Вибираємо режим HIGHRES із oversampling x4.
#define TEMP_DELAY 5                                    // Задаємо паузу після запуску вимірювання температури, мс.
#define PRESS_DELAY 15                                  // Задаємо паузу після запуску вимірювання тиску, мс.
#define FILTER_ALPHA 0.25                               // Задаємо коефіцієнт EMA-фільтра.
#define CAL_SAMPLES 60                                  // Задаємо кількість зразків нульового калібрування.
#define CAL_MAX_SAMPLE 150.0                            // Відкидаємо калібрувальні різниці тисків понад 150 Па.
#define ZERO_MIN_BAND 10.0                              // Задаємо мінімальну зону нуля, Па.
#define ZERO_SIGMA 3.0                                  // Задаємо ширину зони нуля як три стандартні відхилення.
#define OUTPUT_PERIOD 40                                // Задаємо бажаний період виведення даних, мс.
#define CHECK_PERIOD 1000                               // Задаємо період перевірки з'єднання, мс.
const float R_AIR = 287.05;                             // Задаємо газову сталу сухого повітря, Дж/(кг·К).
SoftwareWire softWire(SDA2, SCL2, false, true);        // Створюємо програмну I2C-шину D4/D5 без внутрішніх підтяжок.
struct BMP180 {                                         // Описуємо структуру даних одного датчика BMP180.
  int16_t ac1, ac2, ac3, b1, b2, mb, mc, md;             // Зберігаємо знакові заводські коефіцієнти.
  uint16_t ac4, ac5, ac6;                               // Зберігаємо беззнакові заводські коефіцієнти.
  int32_t B5;                                           // Зберігаємо температурний проміжний параметр B5.
  float temperature;                                    // Зберігаємо останню температуру датчика у °C.
};                                                      // Завершуємо опис структури BMP180.
BMP180 sensorStatic;                                    // Створюємо структуру статичного датчика на A4/A5.
BMP180 sensorPitot;                                     // Створюємо структуру датчика повного тиску на D4/D5.
float zeroDP = 0.0;                                     // Зберігаємо середню нульову різницю між датчиками, Па.
float zeroBand = ZERO_MIN_BAND;                         // Зберігаємо зону нечутливості біля нульового тиску, Па.
float pStaticF = 0.0;                                   // Зберігаємо відфільтрований статичний тиск, Па.
float pPitotF = 0.0;                                    // Зберігаємо відфільтрований повний тиск, Па.
float dPF = 0.0;                                        // Зберігаємо відфільтрований диференціальний тиск, Па.
bool filterReady = false;                               // Позначаємо, чи ініціалізовано фільтри.
byte errorCode = 0;                                     // Зберігаємо поточний код помилки.
byte previousError = 255;                               // Зберігаємо попередній код, щоб не дублювати повідомлення.
unsigned long lastOutput = 0;                           // Зберігаємо час останнього виведення даних.
unsigned long lastCheck = 0;                            // Зберігаємо час останньої перевірки датчиків.
template <typename BUS>                                 // Робимо читання сумісним з Wire і SoftwareWire.
bool readBytes(BUS &bus, byte reg, byte *data, byte count) { // Читаємо задану кількість байтів із BMP180.
  bus.beginTransmission(BMP_ADDR);                      // Починаємо передачу на адресу BMP180.
  bus.write(reg);                                       // Вказуємо адресу початкового регістра.
  if (bus.endTransmission(false) != 0) return false;    // Завершуємо запис без STOP та перевіряємо результат.
  if (bus.requestFrom(BMP_ADDR, count) != count) return false; // Запитуємо та перевіряємо потрібну кількість байтів.
  for (byte i = 0; i < count; i++) data[i] = bus.read(); // Зчитуємо всі байти у буфер.
  return true;                                          // Повертаємо успіх читання.
}                                                       // Завершуємо функцію читання байтів.
template <typename BUS>                                 // Робимо запис сумісним з обома типами I2C-шин.
bool writeByte(BUS &bus, byte reg, byte value) {        // Записуємо один байт у регістр BMP180.
  bus.beginTransmission(BMP_ADDR);                      // Починаємо передачу на адресу BMP180.
  bus.write(reg);                                       // Вказуємо адресу регістра.
  bus.write(value);                                     // Записуємо значення регістра.
  return bus.endTransmission(true) == 0;                // Завершуємо передачу і повертаємо результат.
}                                                       // Завершуємо функцію запису байта.
template <typename BUS>                                 // Робимо перевірку сумісною з обома I2C-шинами.
bool sensorPresent(BUS &bus) {                          // Перевіряємо наявність BMP180 на шині.
  byte id = 0;                                          // Створюємо змінну для ідентифікатора мікросхеми.
  if (!readBytes(bus, REG_ID, &id, 1)) return false;    // Читаємо регістр ID і перевіряємо зв'язок.
  return id == 0x55;                                    // Повертаємо true, якщо ID відповідає BMP180.
}                                                       // Завершуємо перевірку наявності датчика.
template <typename BUS>                                 // Робимо завантаження коефіцієнтів універсальним.
bool loadCalibration(BUS &bus, BMP180 &s) {             // Зчитуємо заводські коефіцієнти конкретного датчика.
  byte data[22];                                        // Створюємо буфер для 22 байтів калібрування.
  if (!readBytes(bus, REG_CAL, data, 22)) return false; // Читаємо блок коефіцієнтів і перевіряємо помилку.
  s.ac1 = (int16_t)(((uint16_t)data[0] << 8) | data[1]); // Відновлюємо коефіцієнт AC1.
  s.ac2 = (int16_t)(((uint16_t)data[2] << 8) | data[3]); // Відновлюємо коефіцієнт AC2.
  s.ac3 = (int16_t)(((uint16_t)data[4] << 8) | data[5]); // Відновлюємо коефіцієнт AC3.
  s.ac4 = (uint16_t)(((uint16_t)data[6] << 8) | data[7]); // Відновлюємо коефіцієнт AC4.
  s.ac5 = (uint16_t)(((uint16_t)data[8] << 8) | data[9]); // Відновлюємо коефіцієнт AC5.
  s.ac6 = (uint16_t)(((uint16_t)data[10] << 8) | data[11]); // Відновлюємо коефіцієнт AC6.
  s.b1 = (int16_t)(((uint16_t)data[12] << 8) | data[13]); // Відновлюємо коефіцієнт B1.
  s.b2 = (int16_t)(((uint16_t)data[14] << 8) | data[15]); // Відновлюємо коефіцієнт B2.
  s.mb = (int16_t)(((uint16_t)data[16] << 8) | data[17]); // Відновлюємо коефіцієнт MB.
  s.mc = (int16_t)(((uint16_t)data[18] << 8) | data[19]); // Відновлюємо коефіцієнт MC.
  s.md = (int16_t)(((uint16_t)data[20] << 8) | data[21]); // Відновлюємо коефіцієнт MD.
  return true;                                          // Повертаємо успішний результат завантаження.
}                                                       // Завершуємо завантаження калібрування.
template <typename BUS>                                 // Робимо запуск вимірювання температури універсальним.
bool startTemperature(BUS &bus) {                       // Запускаємо вимірювання температури BMP180.
  return writeByte(bus, REG_CONTROL, CMD_TEMP);         // Записуємо команду вимірювання температури.
}                                                       // Завершуємо запуск температури.
template <typename BUS>                                 // Робимо читання температури універсальним.
bool finishTemperature(BUS &bus, BMP180 &s) {           // Читаємо температуру та розраховуємо параметр B5.
  byte data[2];                                         // Створюємо буфер для двох байтів результату.
  if (!readBytes(bus, REG_DATA, data, 2)) return false; // Зчитуємо температуру і перевіряємо помилку.
  uint16_t UT = ((uint16_t)data[0] << 8) | data[1];     // Об'єднуємо байти у сире значення температури UT.
  int32_t X1 = (((int32_t)UT - s.ac6) * s.ac5) >> 15;   // Розраховуємо перший проміжний параметр температури.
  int32_t denominator = X1 + s.md;                      // Обчислюємо знаменник другого проміжного параметра.
  if (denominator == 0) return false;                   // Не допускаємо ділення на нуль.
  int32_t X2 = ((int32_t)s.mc << 11) / denominator;      // Розраховуємо другий проміжний параметр температури.
  s.B5 = X1 + X2;                                       // Отримуємо параметр B5 для температури та тиску.
  s.temperature = ((s.B5 + 8) >> 4) / 10.0;             // Перетворюємо результат у градуси Цельсія.
  return true;                                          // Повертаємо успішний результат.
}                                                       // Завершуємо читання температури.
template <typename BUS>                                 // Робимо запуск вимірювання тиску універсальним.
bool startPressure(BUS &bus) {                          // Запускаємо вимірювання тиску BMP180.
  byte command = CMD_PRESS + (OSS << 6);                // Формуємо команду вимірювання тиску з OSS=2.
  return writeByte(bus, REG_CONTROL, command);          // Записуємо команду у регістр керування.
}                                                       // Завершуємо запуск тиску.
template <typename BUS>                                 // Робимо читання тиску універсальним.
bool finishPressure(BUS &bus, BMP180 &s, float &pressure) { // Читаємо сирий тиск і компенсуємо його за коефіцієнтами.
  byte data[3];                                         // Створюємо буфер для трьох байтів тиску.
  if (!readBytes(bus, REG_DATA, data, 3)) return false; // Зчитуємо тиск і перевіряємо помилку.
  uint32_t UP = (((uint32_t)data[0] << 16) | ((uint32_t)data[1] << 8) | data[2]) >> (8 - OSS); // Формуємо сирий тиск UP.
  int32_t B6 = s.B5 - 4000;                             // Розраховуємо параметр B6.
  int32_t X1 = ((int32_t)s.b2 * ((B6 * B6) >> 12)) >> 11; // Розраховуємо перший параметр X1.
  int32_t X2 = ((int32_t)s.ac2 * B6) >> 11;             // Розраховуємо другий параметр X2.
  int32_t X3 = X1 + X2;                                 // Об'єднуємо X1 і X2.
  int32_t B3 = ((((int32_t)s.ac1 * 4 + X3) << OSS) + 2) >> 2; // Розраховуємо поправку B3.
  X1 = ((int32_t)s.ac3 * B6) >> 13;                     // Розраховуємо X1 для поправки B4.
  X2 = ((int32_t)s.b1 * ((B6 * B6) >> 12)) >> 16;       // Розраховуємо X2 для поправки B4.
  X3 = (X1 + X2 + 2) >> 2;                             // Обчислюємо X3 для поправки B4.
  uint32_t B4 = ((uint32_t)s.ac4 * (uint32_t)(X3 + 32768)) >> 15; // Розраховуємо поправку B4.
  if (B4 == 0 || UP < (uint32_t)B3) return false;       // Захищаємося від ділення на нуль і неправильного UP.
  uint32_t B7 = (UP - (uint32_t)B3) * (50000UL >> OSS); // Розраховуємо параметр B7 з урахуванням OSS.
  int32_t p;                                            // Створюємо змінну проміжного тиску.
  if (B7 < 0x80000000UL) p = (int32_t)((B7 * 2) / B4); // Виконуємо першу гілку алгоритму BMP180.
  else p = (int32_t)((B7 / B4) * 2);                    // Виконуємо другу гілку алгоритму BMP180.
  X1 = (p >> 8) * (p >> 8);                             // Розраховуємо першу фінальну поправку.
  X1 = (X1 * 3038L) >> 16;                              // Масштабуємо першу фінальну поправку.
  X2 = (-7357L * p) >> 16;                              // Розраховуємо другу фінальну поправку.
  p = p + ((X1 + X2 + 3791L) >> 4);                     // Отримуємо компенсований тиск у Паскалях.
  pressure = (float)p;                                  // Повертаємо тиск у змінній pressure.
  return true;                                          // Повідомляємо про успішний розрахунок тиску.
}                                                       // Завершуємо читання тиску.
template <typename BUS1, typename BUS2>                  // Робимо спільний цикл сумісним з апаратною та програмною шинами.
bool measurePair(BUS1 &bus1, BMP180 &s1, BUS2 &bus2, BMP180 &s2, float &p1, float &p2) { // Вимірюємо обидва датчики за один цикл.
  if (!startTemperature(bus1)) return false;            // Запускаємо вимірювання температури першого датчика.
  if (!startTemperature(bus2)) return false;            // Запускаємо вимірювання температури другого датчика.
  delay(TEMP_DELAY);                                    // Чекаємо завершення обох вимірювань температури.
  if (!finishTemperature(bus1, s1)) return false;       // Зчитуємо температуру першого датчика та параметр B5.
  if (!finishTemperature(bus2, s2)) return false;       // Зчитуємо температуру другого датчика та параметр B5.
  if (s1.temperature < -40 || s1.temperature > 85) return false; // Перевіряємо діапазон температури першого датчика.
  if (s2.temperature < -40 || s2.temperature > 85) return false; // Перевіряємо діапазон температури другого датчика.
  if (!startPressure(bus1)) return false;               // Запускаємо вимірювання тиску першого датчика.
  if (!startPressure(bus2)) return false;               // Запускаємо вимірювання тиску другого датчика.
  delay(PRESS_DELAY);                                   // Чекаємо завершення обох вимірювань тиску.
  if (!finishPressure(bus1, s1, p1)) return false;      // Зчитуємо та компенсуємо тиск першого датчика.
  if (!finishPressure(bus2, s2, p2)) return false;      // Зчитуємо та компенсуємо тиск другого датчика.
  if (p1 < 30000 || p1 > 110000) return false;          // Перевіряємо допустимий діапазон статичного тиску.
  if (p2 < 30000 || p2 > 110000) return false;          // Перевіряємо допустимий діапазон повного тиску.
  return true;                                          // Повертаємо успіх парного вимірювання.
}                                                       // Завершуємо парне вимірювання.
bool calibrateZero() {                                  // Калібруємо різницю тисків при нерухомій трубці Піто.
  float sum = 0.0;                                      // Обнуляємо суму різниць тисків.
  float sumSq = 0.0;                                    // Обнуляємо суму квадратів різниць тисків.
  byte good = 0;                                        // Обнуляємо лічильник успішних вимірювань.
  Serial.println(F("CALIBRATION"));                    // Повідомляємо про початок калібрування.
  Serial.println(F("KEEP PITOT STILL"));                // Нагадуємо не створювати потік повітря під час калібрування.
  for (byte i = 0; i < 10; i++) {                       // Виконуємо десять прогрівальних вимірювань.
    float ps = 0.0;                                     // Створюємо змінну статичного тиску для прогріву.
    float pt = 0.0;                                     // Створюємо змінну повного тиску для прогріву.
    measurePair(Wire, sensorStatic, softWire, sensorPitot, ps, pt); // Прогріваємо обидва датчики без використання результату.
  }                                                     // Завершуємо прогрів датчиків.
  for (byte i = 0; i < CAL_SAMPLES; i++) {               // Виконуємо серію вимірювань для калібрування.
    float ps = 0.0;                                     // Створюємо змінну статичного тиску.
    float pt = 0.0;                                     // Створюємо змінну повного тиску.
    if (!measurePair(Wire, sensorStatic, softWire, sensorPitot, ps, pt)) continue; // Пропускаємо невдале парне вимірювання.
    float dp = pt - ps;                                 // Розраховуємо різницю повного та статичного тисків.
    if (fabs(dp) > CAL_MAX_SAMPLE) continue;            // Відкидаємо явні викиди або потік повітря під час калібрування.
    sum += dp;                                           // Додаємо різницю до загальної суми.
    sumSq += dp * dp;                                   // Додаємо квадрат різниці до суми квадратів.
    good++;                                              // Зараховуємо вимірювання як успішне.
  }                                                     // Завершуємо серію калібрування.
  if (good < (CAL_SAMPLES * 8) / 10) return false;      // Вимагаємо не менше 80 відсотків успішних зразків.
  float mean = sum / good;                              // Обчислюємо середню різницю тисків.
  float variance = (sumSq / good) - (mean * mean);      // Оцінюємо дисперсію шуму різниці тисків.
  if (variance < 0.0) variance = 0.0;                   // Прибираємо можливу похибку округлення.
  float sigma = sqrt(variance);                         // Обчислюємо стандартне відхилення шуму.
  zeroDP = mean;                                        // Зберігаємо середню різницю як нульову поправку.
  zeroBand = ZERO_SIGMA * sigma;                        // Встановлюємо зону нуля за виміряним рівнем шуму.
  if (zeroBand < ZERO_MIN_BAND) zeroBand = ZERO_MIN_BAND; // Застосовуємо мінімальну ширину зони нуля.
  if (zeroBand > 100.0) return false;                   // Відхиляємо калібрування, якщо шум надто великий.
  Serial.print(F("ZERO_DP="));                         // Починаємо виведення нульової поправки.
  Serial.print(zeroDP, 2);                              // Виводимо нульову поправку у Паскалях.
  Serial.println(F(" Pa"));                            // Вказуємо одиницю вимірювання.
  Serial.print(F("ZERO_SIGMA="));                      // Починаємо виведення стандартного відхилення.
  Serial.print(sigma, 2);                               // Виводимо стандартне відхилення у Паскалях.
  Serial.println(F(" Pa"));                            // Вказуємо одиницю вимірювання.
  Serial.print(F("ZERO_BAND="));                       // Починаємо виведення зони нуля.
  Serial.print(zeroBand, 2);                            // Виводимо ширину зони нуля у Паскалях.
  Serial.println(F(" Pa"));                            // Вказуємо одиницю вимірювання.
  return true;                                          // Повідомляємо про успішне калібрування.
}                                                       // Завершуємо автоматичне калібрування.
void reportError(byte code) {                           // Виводимо повідомлення лише тоді, коли код помилки змінюється.
  errorCode = code;                                     // Зберігаємо поточний код помилки.
  if (errorCode == previousError) return;               // Не дублюємо незмінне повідомлення.
  previousError = errorCode;                            // Зберігаємо останній виведений код помилки.
  Serial.print(F("ERROR="));                           // Виводимо мітку помилки.
  Serial.print(errorCode);                              // Виводимо числовий код помилки.
  Serial.print(F(" "));                                // Додаємо пробіл перед текстовим описом.
  if (code == 0) Serial.println(F("OK"));               // Код 0 означає нормальну роботу.
  else if (code == 1) Serial.println(F("STATIC SENSOR")); // Код 1 означає проблему статичного датчика.
  else if (code == 2) Serial.println(F("PITOT SENSOR")); // Код 2 означає проблему датчика Піто.
  else if (code == 3) Serial.println(F("CALIBRATION")); // Код 3 означає помилку нульового калібрування.
  else if (code == 4) Serial.println(F("MEASUREMENT")); // Код 4 означає помилку читання вимірювання.
  else if (code == 5) Serial.println(F("PRESSURE"));    // Код 5 означає недопустиме значення тиску.
  else if (code == 6) Serial.println(F("TEMPERATURE")); // Код 6 означає недопустиму температуру.
  else if (code == 7) Serial.println(F("DENSITY"));     // Код 7 означає недопустиму густину повітря.
  else Serial.println(F("UNKNOWN"));                    // Інші коди означають невідому помилку.
}                                                       // Завершуємо функцію повідомлення про помилку.
void stopWithError(byte code) {                         // Зупиняємо запуск, якщо виникла критична помилка.
  reportError(code);                                    // Виводимо опис критичної помилки.
  while (true) delay(1000);                             // Залишаємо Arduino у зупиненому стані до перезапуску.
}                                                       // Завершуємо функцію критичної зупинки.
void setup() {                                           // Виконуємо початкове налаштування Arduino Nano.
  Serial.begin(115200);                                 // Запускаємо послідовний порт зі швидкістю 115200 бод.
  Wire.begin();                                         // Запускаємо апаратну I2C-шину на A4/A5.
  softWire.begin();                                     // Запускаємо програмну I2C-шину на D4/D5.
  Wire.setClock(100000);                                // Встановлюємо апаратній шині частоту 100 кГц.
  softWire.setClock(100000);                            // Встановлюємо програмній шині частоту 100 кГц.
  Serial.println(F("PITOT START"));                    // Повідомляємо про запуск системи Піто.
  if (!sensorPresent(Wire)) stopWithError(1);           // Перевіряємо наявність статичного BMP180.
  if (!sensorPresent(softWire)) stopWithError(2);       // Перевіряємо наявність BMP180 Піто.
  if (!loadCalibration(Wire, sensorStatic)) stopWithError(1); // Зчитуємо заводські коефіцієнти статичного датчика.
  if (!loadCalibration(softWire, sensorPitot)) stopWithError(2); // Зчитуємо заводські коефіцієнти датчика Піто.
  if (!calibrateZero()) stopWithError(3);               // Виконуємо автоматичне калібрування нуля.
  Serial.println(F("READY"));                          // Повідомляємо, що система готова до вимірювань.
  reportError(0);                                       // Виводимо повідомлення про нормальний стан один раз.
}                                                       // Завершуємо початкове налаштування.
void loop() {                                           // Починаємо основний цикл вимірювання.
  unsigned long now = millis();                         // Зчитуємо поточний час роботи Arduino.
  if (now - lastCheck >= CHECK_PERIOD) {                // Періодично перевіряємо доступність обох датчиків.
    lastCheck = now;                                    // Запам'ятовуємо час перевірки.
    if (!sensorPresent(Wire)) { reportError(1); return; } // Повідомляємо про втрату статичного датчика.
    if (!sensorPresent(softWire)) { reportError(2); return; } // Повідомляємо про втрату датчика Піто.
  }                                                     // Завершуємо періодичну перевірку датчиків.
  if (now - lastOutput < OUTPUT_PERIOD) return;         // Чекаємо завершення інтервалу оновлення.
  lastOutput = now;                                     // Запам'ятовуємо час нового циклу.
  float ps = 0.0;                                       // Створюємо змінну статичного тиску.
  float pt = 0.0;                                       // Створюємо змінну повного тиску.
  if (!measurePair(Wire, sensorStatic, softWire, sensorPitot, ps, pt)) { reportError(4); return; } // Вимірюємо обидва датчики.
  float correctedDP = (pt - ps) - zeroDP;                // Віднімаємо автоматично знайдену нульову похибку.
  if (fabs(correctedDP) <= zeroBand) correctedDP = 0.0; // Прибираємо шум, що потрапляє всередину зони нуля.
  if (correctedDP < 0.0) correctedDP = 0.0;             // Не використовуємо від'ємний динамічний тиск для швидкості.
  if (!filterReady) {                                   // Ініціалізуємо фільтри під час першого успішного вимірювання.
    pStaticF = ps;                                      // Задаємо початкове значення статичного тиску.
    pPitotF = pt;                                       // Задаємо початкове значення повного тиску.
    dPF = correctedDP;                                  // Задаємо початкове значення диференціального тиску.
    filterReady = true;                                 // Позначаємо фільтри як ініціалізовані.
  }                                                     // Завершуємо початкове налаштування фільтрів.
  pStaticF += FILTER_ALPHA * (ps - pStaticF);            // Фільтруємо статичний тиск.
  pPitotF += FILTER_ALPHA * (pt - pPitotF);              // Фільтруємо повний тиск.
  dPF += FILTER_ALPHA * (correctedDP - dPF);             // Фільтруємо диференціальний тиск.
  float temperatureK = sensorStatic.temperature + 273.15; // Переводимо температуру статичного датчика у Кельвіни.
  if (temperatureK <= 0.0) { reportError(6); return; }  // Перевіряємо допустимість абсолютної температури.
  float rho = pStaticF / (R_AIR * temperatureK);         // Розраховуємо густину повітря за тиском і температурою.
  if (rho <= 0.0 || rho > 2.0) { reportError(7); return; } // Перевіряємо фізично правдоподібну густину повітря.
  float speed = sqrt((2.0 * dPF) / rho);                 // Розраховуємо швидкість потоку за формулою Піто.
  reportError(0);                                       // Повідомляємо про відновлення нормальної роботи за потреби.
  Serial.print(F("T1="));                               // Починаємо виведення температури першого датчика.
  Serial.print(sensorStatic.temperature, 1);            // Виводимо температуру першого датчика у градусах Цельсія.
  Serial.print(F(" T2="));                              // Починаємо виведення температури другого датчика.
  Serial.print(sensorPitot.temperature, 1);              // Виводимо температуру другого датчика у градусах Цельсія.
  Serial.print(F(" Ps="));                              // Починаємо виведення статичного тиску.
  Serial.print(pStaticF, 0);                             // Виводимо статичний тиск у Паскалях.
  Serial.print(F(" Pt="));                              // Починаємо виведення повного тиску.
  Serial.print(pPitotF, 0);                              // Виводимо повний тиск у Паскалях.
  Serial.print(F(" dP="));                              // Починаємо виведення диференціального тиску.
  Serial.print(dPF, 1);                                  // Виводимо динамічний тиск у Паскалях.
  Serial.print(F(" V="));                               // Починаємо виведення швидкості повітря.
  Serial.print(speed, 2);                                // Виводимо швидкість у метрах за секунду.
  Serial.print(F(" rho="));                             // Починаємо виведення густини повітря.
  Serial.print(rho, 3);                                  // Виводимо густину у кг/м³.
  Serial.print(F(" ERR="));                             // Починаємо виведення коду помилки.
  Serial.println(errorCode);                             // Виводимо код стану в кінці рядка.
}                                                       // Завершуємо основний цикл Arduino.
